// SPDX-License-Identifier: GPL-2.0-only OR MIT
/*
 * DT Overlay to use GPIO24 (TX) and GPIO7 (RX) within the expansion header for WKUP_UART0 (ttyS0).
 *
 * Copyright (C) 2025 T3 Foundation - https://www.t3vakfi.org/
 */

/dts-v1/;
/plugin/;

#include <dt-bindings/gpio/gpio.h>
#include "k3-pinctrl.h"

&mcu_pmx0 {
	hat_18_hat_26_ttys0_pins: hat-18-hat-26-ttys0-pins {
		pinctrl-single,pins = <
			J722S_MCU_IOPAD(0x0028, PIN_OUTPUT, 0) /* (D7) WKUP_UART0_TXD */
			J722S_MCU_IOPAD(0x0024, PIN_INPUT, 0)  /* (D8) WKUP_UART0_RXD */
		>;
	};
};

&wkup_uart0 {
	pinctrl-names = "default";
	pinctrl-0 = <&hat_18_hat_26_ttys0_pins>;
	status = "okay";
};
