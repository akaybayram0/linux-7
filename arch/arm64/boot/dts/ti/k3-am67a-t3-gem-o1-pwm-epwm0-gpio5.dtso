// SPDX-License-Identifier: GPL-2.0-only OR MIT
/*
 * DT Overlay to use GPIO5 (PWM0) within the expansion header for EPWM0 (pwmchip3).
 *
 * Copyright (C) 2023 Texas Instruments Incorporated - https://www.ti.com/
 */

/dts-v1/;
/plugin/;

#include <dt-bindings/gpio/gpio.h>
#include "k3-pinctrl.h"

/*
 * Helper to show loaded overlays under: /proc/device-tree/chosen/overlays/
*/
&main_pmx0 {
	hat_29_pwm: hat-29-pwm-pins {
		pinctrl-single,pins = <
			J722S_IOPAD(0x1B4, PIN_OUTPUT, 2) /* (B20) SPI0_CS0.EHRPWM0_A */
		>;
	};
};

&epwm0 {
	pinctrl-names = "default";
	pinctrl-0 = <&hat_29_pwm>;
	status = "okay";
};
