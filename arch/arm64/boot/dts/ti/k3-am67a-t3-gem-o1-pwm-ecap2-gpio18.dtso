// SPDX-License-Identifier: GPL-2.0-only OR MIT
/*
 * DT Overlay to use GPIO18 (PWM0) within the expansion header for ECAP2 (pwmchip2).
 *
 * Copyright (C) 2023 Texas Instruments Incorporated - https://www.ti.com/
 */

/dts-v1/;
/plugin/;

#include <dt-bindings/gpio/gpio.h>
#include "k3-pinctrl.h"

/*
 * Helper to show loaded overlays under: /proc/device-tree/chosen/overlays/
*/
&main_pmx0 {
	hat_12_pwm_ecap: hat-12-pwm-ecap-pins {
		pinctrl-single,pins = <
			J722S_IOPAD(0x1A4, PIN_OUTPUT, 2) /* (D25) MCASP0_ACLKX.ECAP2_IN_APWM_OUT */
		>;
	};
};

&ecap2 {
	pinctrl-names = "default";
	pinctrl-0 = <&hat_12_pwm_ecap>;
	status = "okay";
};
