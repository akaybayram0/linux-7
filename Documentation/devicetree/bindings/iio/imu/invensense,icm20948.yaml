## Documentation/devicetree/bindings/iio/imu/invensense,icm20948.yaml
```yaml
# SPDX-License-Identifier: (GPL-2.0-only OR BSD-2-Clause)
%YAML 1.2
---
$id: http://devicetree.org/schemas/iio/imu/invensense,icm20948.yaml#
$schema: http://devicetree.org/meta-schemas/core.yaml#

title: InvenSense ICM-20948 Inertial Measurement Unit

maintainers:
  - Your Name <you@example.com>

description: |
  9-axis motion-tracking device that combines a 3-axis gyroscope, 3-axis
  accelerometer and a 3-axis magnetometer (AK09916, reached through the
  chip's internal I2C master, so it works over both I2C and SPI).

  Over SPI the driver uses mode 3 (CPOL=1, CPHA=1), so SPI nodes should set
  both spi-cpol and spi-cpha.

  https://invensense.tdk.com/wp-content/uploads/2024/03/DS-000189-ICM-20948-v1.6.pdf

allOf:
  - $ref: /schemas/spi/spi-peripheral-props.yaml#

properties:
  compatible:
    const: invensense,icm20948

  reg:
    maxItems: 1

  interrupts:
    maxItems: 1
    description: Data-ready / FIFO interrupt line (INT1 pin).

  vdd-supply: true

  vddio-supply: true

  spi-max-frequency:
    maximum: 7000000

  mount-matrix:
    description:
      Orientation of the chip relative to the board, as a 3x3 matrix. The
      driver exposes it as in_*_mount_matrix; it does not rotate the data.

required:
  - compatible
  - reg

unevaluatedProperties: false

examples:
  - |
    #include <dt-bindings/interrupt-controller/irq.h>

    i2c {
        #address-cells = <1>;
        #size-cells = <0>;

        imu@68 {
            compatible = "invensense,icm20948";
            reg = <0x68>;
            interrupt-parent = <&gpio2>;
            interrupts = <7 IRQ_TYPE_EDGE_FALLING>;
            vdd-supply = <&vdd>;
            vddio-supply = <&vddio>;
            mount-matrix = "1", "0", "0",
                           "0", "1", "0",
                           "0", "0", "1";
        };
    };
  - |
    spi {
        #address-cells = <1>;
        #size-cells = <0>;

        imu@0 {
            compatible = "invensense,icm20948";
            reg = <0>;
            spi-max-frequency = <7000000>;
            spi-cpha;
            spi-cpol;
            vdd-supply = <&vdd>;
            vddio-supply = <&vddio>;
            mount-matrix = "1", "0", "0",
                           "0", "1", "0",
                           "0", "0", "1";
        };
    };
```
